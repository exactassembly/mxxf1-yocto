## meta-mxxf1/conf/distro/dr-distro.conf
```bitbake
require conf/distro/poky.conf

DISTRO_NAME = "DR imx6 Scarthgap"

DISTRO_FEATURES_DEFAULT = "systemd opengl fbdev alsa usbgadget usbhost wifi xattr zeroconf pam bluetooth polkit"

INIT_MANAGER = "systemd"
DISTRO_FEATURES:remove = "wayland vulkan pulseaudio sysvinit"
PACKAGECONFIG:remove:pn-systemd = "\
	vconsole \
	quotacheck \
	hibernate \
	ima \
	smack \
"

PACKAGECONFIG:pn-libgpiod = "cxx python3"
PACKAGECONFIG:append:pn-qtbase = " accessibility fontconfig linuxfb"
LICENSE_FLAGS_ACCEPTED:append = " non-commercial"
PACKAGECONFIG:remove:pn-qtmultimedia = "gstreamer"
```

## meta-mxxf1/conf/distro/tmtx-dr-distro.conf
```bitbake
require conf/distro/include/fslc-base.inc

DISTRO_NAME = "TMTX for DataRespons imx6 Scarthgap"

DISTRO_FEATURES:remove = "directfb"
DISTRO_FEATURES:append = "systemd opengl usbgadget usbhost xattr zeroconf pam polkit weston wayland xwayland"

INIT_MANAGER = "systemd"
DISTRO_FEATURES:remove = "vulkan pulseaudio sysvinit"
PACKAGECONFIG:remove:pn-systemd = "\
	vconsole \
	quotacheck \
	hibernate \
	ima \
	smack \
"

PACKAGECONFIG:pn-libgpiod = "cxx python3"
PACKAGECONFIG:append:pn-qtbase = " accessibility fontconfig linuxfb"
LICENSE_FLAGS_ACCEPTED:append = " non-commercial"
PACKAGECONFIG:remove:pn-qtmultimedia = "gstreamer"
```

## meta-mxxf1/conf/machine/dr-imx6-mc.conf
```bitbake
#@TYPE: Machine
#@NAME: i.MX6Q MXXF1
#@DESCRIPTION: Machine configuration for DATARESPONS i.MX6Q MXXF1

MACHINEOVERRIDES =. "mx6q:mx6dl:"
IMX_DEFAULT_BSP = "nxp"

require conf/machine/include/imx-base.inc
require conf/machine/include/arm/armv7a/tune-cortexa9.inc

KERNEL_DEVICETREE = "nxp/imx/mxxf1-hw4.dtb"

SERIAL_CONSOLES = "115200;ttymxc0"

WKS_FILE = "dr-imx6-mc-nobootloader.wks"

MACHINE_FEATURES:append = "alsa pci wifi ext2 vfat usbgadget usbhost sound"
MACHINE_ESSENTIAL_EXTRA_RDEPENDS += "kernel-devicetree kernel-modules"
MACHINE_EXTRA_RRECOMMENDS += "packagegroup-dr-hardware"

#MACHINE_ESSENTIAL_EXTRA_RDEPENDS +=  imx6-fixup"

PREFERRED_PROVIDER_virtual/bootloader = "uboot-dr-fake"

#MACHINE_EXTRA_RRECOMMENDS += "mxxf1-hostname ${@bb.utils.contains('DISTRO_FEATURES', 'x11', '', 'qt5-eglfs-mxxf1', d)}"
#
#KERNEL_IMAGETYPE = "zImage"
#MACHINE_USES_VIVANTE_KERNEL_DRIVER_MODULE = "0"
```

## meta-mxxf1/wic/dr-imx6-mc-nobootloader.wks
```
# short-description: Create SD card image without boot partition or bootloader
# long-description:

part / --source rootfs --ondisk mmcblk --fstype=ext4 --label root --align 8192

bootloader --ptable msdos
```

## meta-thrustmastertx/conf/layer.conf
```bitbake
# We have a conf and classes directory, add to BBPATH
BBPATH .= ":${LAYERDIR}"

# We have a packages directory, add to BBFILES
BBFILES += "${LAYERDIR}/recipes-*/*/*.bb \
            ${LAYERDIR}/recipes-*/*/*.bbappend"

BBFILE_COLLECTIONS += "meta-thrustmastertx"
BBFILE_PATTERN_meta-thrustmastertx := "^${LAYERDIR}/"
BBFILE_PRIORITY_meta-thrustmastertx = "8"

LAYERSERIES_COMPAT_meta-thrustmastertx = "scarthgap"
```
